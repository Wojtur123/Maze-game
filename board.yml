## board.yml
```yaml
player_position: [1, 1, 0]
board: [["_", "_", "_", "_", "_", "_", "_", "_", "_", "_", "_", "_", "_", "_", "_", "_"],
        ["|", " ", " ", " ", "|", " ", " ", " ", " ", " ", " ", " ", " ", " ", " ", "|"],
        ["|", " ", " ", " ", "|", " ", " ", " ", " ", " ", " ", " ", " ", " ", " ", "|"],
        ["|", " ", " ", " ", "|", " ", " ", " ", " ", " ", " ", " ", " ", " ", " ", "|"],
        ["|", " ", " ", " ", " ", " ", " ", " ", " ", " ", " ", " ", " ", " ", " ", "|"],
        ["|", " ", " ", " ", "x", " ", " ", " ", " ", " ", " ", " ", " ", " ", " ", "|"],
        ["|", " ", " ", " ", " ", " ", " ", " ", " ", " ", " ", " ", " ", " ", " ", "|"],
        ["|", " ", " ", " ", " ", " ", "x", " ", " ", " ", " ", " ", " ", " ", " ", "|"],
        ["|", " ", " ", " ", " ", " ", " ", " ", " ", " ", " ", " ", " ", " ", " ", "|"],
        ["|", " ", " ", " ", " ", " ", " ", " ", " ", " ", " ", " ", " ", " ", " ", "|"],
        ["|", "_", "_", "_", "_", "_", "_", "_", " ", "x", " ", " ", " ", " ", " ", "|"],
        ["|", " ", " ", " ", " ", " ", " ", " ", " ", " ", " ", " ", " ", " ", " ", "|"],
        ["|", " ", " ", " ", "#", "x", " ", " ", " ", " ", " ", " ", " ", " ", " ", "|"],
        ["|", " ", " ", " ", " ", " ", " ", " ", " ", " ", " ", " ", " ", " ", " ", "|"],
        ["|", " ", " ", " ", " ", " ", " ", "x", " ", " ", " ", " ", " ", " ", " ", "|"],
        ["|", "_", "_", "_", "_", "_", "_", "_", "_", "_", "_", "_", "_", "_", "_", "|"]]
```
